/*
 * SPDX-License-Identifier: Apache-2.0
 */

/dts-v1/;

#include <chipyard/penguin.dtsi>

/ {
	chosen {
		zephyr,console = &htif;
		zephyr,shell-uart = &htif;
		zephyr,sram = &ram0;
	};
};

&htif {
	status = "okay";
};

&uart0 {
	status = "okay";
	current-speed = <115200>;
};
