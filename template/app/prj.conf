## CMakeLists.txt
```
# SPDX-License-Identifier: Apache-2.0

cmake_minimum_required(VERSION 3.20.0)
find_package(Zephyr REQUIRED HINTS $ENV{ZEPHYR_BASE})
project(my_app)

target_sources(app PRIVATE src/main.c)
```

## prj.conf
```kconfig
# Kconfig options for this app.
CONFIG_PRINTK=y
```

## src/main.c
```c
/*
 * SPDX-License-Identifier: Apache-2.0
 *
 * Template app: print, then end the simulation with an exit code, which becomes the
 * simulator's exit status (0 = pass).
 */
#include <zephyr/kernel.h>
#include <zephyr/sys/printk.h>
#include <chipyard/sim_exit.h>

int main(void)
{
	printk("Hello from %s\n", CONFIG_BOARD_TARGET);

	chipyard_sim_exit(0);
}
```
