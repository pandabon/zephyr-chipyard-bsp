## boards/chipyard/penguin/Kconfig.chipyard_penguin
```kconfig
# SPDX-License-Identifier: Apache-2.0

config BOARD_CHIPYARD_PENGUIN
	select SOC_PENGUIN
```

## boards/chipyard/penguin/board.yml
```yaml
# SPDX-License-Identifier: Apache-2.0
board:
  name: chipyard_penguin
  full_name: Chipyard Penguin (Shuttle + Saturn RVV)
  vendor: chipyard
  socs:
    - name: penguin
      variants:
        - name: vcu118
        - name: vcu118_ta
```

## dts/bindings/accel/ucb-bar,atlas.yaml
```yaml
# SPDX-License-Identifier: Apache-2.0

description: |
  Atlas NPU: a memory-mapped TileLink device (not a hart, not RoCC).

  Three fixed windows (reg-names, in this order):
    imem  flat instruction memory, PBUS, 32-bit access, default 128 KiB @ 0x00020000
    csr   control/status block, PBUS, 32-bit access, 4 KiB window (7 words used) @ 0x00040000
    vmem  vector scratchpad, SBUS, 1..32 byte access, default 1.5 MiB @ 0x20000000

  Sources (bringup-chipyard/generators/atlas-npu/src/main/scala/atlas/):
    scalar/ScalarCore.scala   AtlasMemMap: imem/csr/vmem base and size
    diplomatic/memory/CSRFile.scala   CSR register list (7 registers)
    common/VmemParams.scala   bank count and bank size (size / numBanks)
    diplomatic/top/AtlasTile.scala   bus attachment (PBUS/SBUS)

  Chipyard emits no DTS node for Atlas, so the node is written by hand. There is no
  "interrupts" property because the RTL has no interrupt output; completion is polled via the
  status CSR. There is no DMA window: the DMA engine is a TileLink client driven only by
  kernel instructions.

  Example:

    atlas: npu@20000 {
        compatible = "ucb-bar,atlas";
        reg = <0x00020000 0x00020000>,
              <0x00040000 0x00001000>,
              <0x20000000 0x00180000>;
        reg-names = "imem", "csr", "vmem";
        vmem-banks = <6>;
    };

compatible: "ucb-bar,atlas"

include: base.yaml

properties:
  reg:
    required: true

  reg-names:
    required: true
    description: |
      Exactly "imem", "csr", "vmem", in the same order as "reg".

  vmem-banks:
    type: int
    description: |
      Number of VMEM banks (bank size = vmem size / vmem-banks). The RTL default is 6 banks
      of 256 KiB (VmemParams.scala).
```

## dts/bindings/cpu/ucb-bar,shuttle.yaml
```yaml
# SPDX-License-Identifier: Apache-2.0

description: UCB-BAR Shuttle superscalar in-order RISC-V core

compatible: "ucb-bar,shuttle"

include: riscv,cpus.yaml
```

## external/atlas_upstream/Kconfig
```kconfig
# SPDX-License-Identifier: Apache-2.0

mainmenu "Atlas upstream host tests (built from tapeout-chipyard)"

config ATLAS_UPSTREAM_TIMEOUT_S
	int "Watchdog: seconds of wall time before the test is declared hung"
	default 120
	help
	  Upstream polls the Atlas status register up to 200 million times before
	  reporting a failure, which takes minutes on a slow link, and some tests
	  have no timeout. The shim runs the test's main() in the main thread
	  and a watchdog thread that, after this many seconds, writes
	  execControl=0 (stops Atlas), prints "ATLASUP <test> TIMEOUT" and ends
	  the run with exit code 124.

	  It cannot help if a bus access never returns; the last line printed
	  before the hang then names the stage.

source "Kconfig.zephyr"
```

## samples/atlas_upstream/sample.yaml
```yaml
# SPDX-License-Identifier: Apache-2.0
# Build only, since Spike has no Atlas model. One scenario per upstream test and board
# variant; run_tests.py builds only the board it is given, so the vcu118_ta ones SKIP by
# default (use --board chipyard_penguin/penguin/vcu118_ta -f atlas_upstream). The 9 tests
# whose golden headers need python torch are not listed (see tests.cmake).
sample:
  name: atlas_upstream
common:
  tags: atlas hardware atlas_upstream needs_path:TAPEOUT_CHIPYARD
  build_only: true
tests:
  sample.penguin.atlas_upstream.atlas_alu_basic:
    platform_allow: chipyard_penguin/penguin
    extra_args: ATLAS_TEST=atlas_alu_basic
  sample.penguin.vcu118_ta.atlas_upstream.atlas_alu_basic:
    platform_allow: chipyard_penguin/penguin/vcu118_ta
    extra_args: ATLAS_TEST=atlas_alu_basic
  sample.penguin.atlas_upstream.saturn_atlas_vmem_smoke:
    platform_allow: chipyard_penguin/penguin
    extra_args: ATLAS_TEST=saturn_atlas_vmem_smoke
  sample.penguin.vcu118_ta.atlas_upstream.saturn_atlas_vmem_smoke:
    platform_allow: chipyard_penguin/penguin/vcu118_ta
    extra_args: ATLAS_TEST=saturn_atlas_vmem_smoke
  sample.penguin.atlas_upstream.saturn_atlas_pause_resume:
    platform_allow: chipyard_penguin/penguin
    extra_args: ATLAS_TEST=saturn_atlas_pause_resume
  sample.penguin.vcu118_ta.atlas_upstream.saturn_atlas_pause_resume:
    platform_allow: chipyard_penguin/penguin/vcu118_ta
    extra_args: ATLAS_TEST=saturn_atlas_pause_resume
  sample.penguin.atlas_upstream.saturn_atlas_pi0_slice:
    platform_allow: chipyard_penguin/penguin
    extra_args: ATLAS_TEST=saturn_atlas_pi0_slice
  sample.penguin.vcu118_ta.atlas_upstream.saturn_atlas_pi0_slice:
    platform_allow: chipyard_penguin/penguin/vcu118_ta
    extra_args: ATLAS_TEST=saturn_atlas_pi0_slice
  sample.penguin.atlas_upstream.saturn_atlas_buffered_optA_end_jal:
    platform_allow: chipyard_penguin/penguin
    extra_args: ATLAS_TEST=saturn_atlas_buffered_optA_end_jal
  sample.penguin.vcu118_ta.atlas_upstream.saturn_atlas_buffered_optA_end_jal:
    platform_allow: chipyard_penguin/penguin/vcu118_ta
    extra_args: ATLAS_TEST=saturn_atlas_buffered_optA_end_jal
  sample.penguin.atlas_upstream.saturn_atlas_buffered_lower_first:
    platform_allow: chipyard_penguin/penguin
    extra_args: ATLAS_TEST=saturn_atlas_buffered_lower_first
  sample.penguin.vcu118_ta.atlas_upstream.saturn_atlas_buffered_lower_first:
    platform_allow: chipyard_penguin/penguin/vcu118_ta
    extra_args: ATLAS_TEST=saturn_atlas_buffered_lower_first
  sample.penguin.atlas_upstream.saturn_atlas_buffered_optB_restart:
    platform_allow: chipyard_penguin/penguin
    extra_args: ATLAS_TEST=saturn_atlas_buffered_optB_restart
  sample.penguin.vcu118_ta.atlas_upstream.saturn_atlas_buffered_optB_restart:
    platform_allow: chipyard_penguin/penguin/vcu118_ta
    extra_args: ATLAS_TEST=saturn_atlas_buffered_optB_restart
  sample.penguin.atlas_upstream.saturn_atlas_vmem_3way_arb:
    platform_allow: chipyard_penguin/penguin
    extra_args: ATLAS_TEST=saturn_atlas_vmem_3way_arb
  sample.penguin.vcu118_ta.atlas_upstream.saturn_atlas_vmem_3way_arb:
    platform_allow: chipyard_penguin/penguin/vcu118_ta
    extra_args: ATLAS_TEST=saturn_atlas_vmem_3way_arb
  sample.penguin.atlas_upstream.saturn_atlas_4rung_2bank_arb:
    platform_allow: chipyard_penguin/penguin
    extra_args: ATLAS_TEST=saturn_atlas_4rung_2bank_arb
  sample.penguin.vcu118_ta.atlas_upstream.saturn_atlas_4rung_2bank_arb:
    platform_allow: chipyard_penguin/penguin/vcu118_ta
    extra_args: ATLAS_TEST=saturn_atlas_4rung_2bank_arb
  sample.penguin.atlas_upstream.saturn_atlas_vmem_dram_dual:
    platform_allow: chipyard_penguin/penguin
    extra_args: ATLAS_TEST=saturn_atlas_vmem_dram_dual
  sample.penguin.vcu118_ta.atlas_upstream.saturn_atlas_vmem_dram_dual:
    platform_allow: chipyard_penguin/penguin/vcu118_ta
    extra_args: ATLAS_TEST=saturn_atlas_vmem_dram_dual
  sample.penguin.atlas_upstream.saturn_atlas_dmem_sbus_dma:
    platform_allow: chipyard_penguin/penguin
    extra_args: ATLAS_TEST=saturn_atlas_dmem_sbus_dma
  sample.penguin.vcu118_ta.atlas_upstream.saturn_atlas_dmem_sbus_dma:
    platform_allow: chipyard_penguin/penguin/vcu118_ta
    extra_args: ATLAS_TEST=saturn_atlas_dmem_sbus_dma
  sample.penguin.atlas_upstream.saturn_atlas_8dma_rvv_vmem:
    platform_allow: chipyard_penguin/penguin
    extra_args: ATLAS_TEST=saturn_atlas_8dma_rvv_vmem
  sample.penguin.vcu118_ta.atlas_upstream.saturn_atlas_8dma_rvv_vmem:
    platform_allow: chipyard_penguin/penguin/vcu118_ta
    extra_args: ATLAS_TEST=saturn_atlas_8dma_rvv_vmem
  sample.penguin.atlas_upstream.saturn_atlas_8dma_rvv_vmem_nosaturn:
    platform_allow: chipyard_penguin/penguin
    extra_args: ATLAS_TEST=saturn_atlas_8dma_rvv_vmem_nosaturn
  sample.penguin.vcu118_ta.atlas_upstream.saturn_atlas_8dma_rvv_vmem_nosaturn:
    platform_allow: chipyard_penguin/penguin/vcu118_ta
    extra_args: ATLAS_TEST=saturn_atlas_8dma_rvv_vmem_nosaturn
```

## samples/hello_rvv/sample.yaml
```yaml
# SPDX-License-Identifier: Apache-2.0
sample:
  name: hello_rvv
tests:
  sample.penguin.hello_rvv:
    platform_allow: chipyard_penguin/penguin
    tags: rvv
    harness: console
    harness_config:
      type: one_line
      regex:
        - "hello_rvv: PASS"
```

## tests/arch/rvv/vlen/testcase.yaml
```yaml
# SPDX-License-Identifier: Apache-2.0
tests:
  arch.riscv.rvv.vlen:
    filter: CONFIG_RISCV_ISA_EXT_V
    harness: ztest
    integration_platforms:
      - chipyard_penguin/penguin
```

## tests/linker/memregion/testcase.yaml
```yaml
# SPDX-License-Identifier: Apache-2.0
tests:
  linker.memregion:
    arch_allow: riscv
    integration_platforms:
      - chipyard_penguin/penguin
    tags: linker
```
